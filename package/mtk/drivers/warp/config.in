## package/mtk/drivers/warp/config.in
```kconfig
if PACKAGE_kmod-warp

config WARP_CONFIG_MODE
	int "WARP Configuration Mode"
	help
		For project Jaguar and before (<= WARP_V3), please use mode = 0
		For project Griffin and later (>= WARP_V3_1), please use mode = 1
	default 0
	default 1 if TARGET_mediatek_mt7987

config WARP_CHIPSET
	string "WARP Driver HW Chipset"
	default mt7622 if TARGET_mediatek_mt7622
	default mt7986 if TARGET_mediatek_mt7986
	default mt7981 if TARGET_mediatek_mt7981
	default mt7988 if TARGET_mediatek_mt7988
	default mt7987 if TARGET_mediatek_mt7987
	help
		Value will be set depending on TARGET, default not need set by user.

config WARP_VERSION
	string "WARP Driver HW Version"
	default 1 if TARGET_mediatek_mt7622
	default 1 if TARGET_airoha_en7563
	default 2 if TARGET_mediatek_mt7986
	default 2 if TARGET_mediatek_mt7981
	default 3 if TARGET_mediatek_mt7988
	default 3_1 if TARGET_mediatek_mt7987
	help
		Value will be set depending on TARGET, default not need set by user.

config WED_HW_RRO_SUPPORT
	bool "WARP Driver WED HW RRO (WO RRO) Support"
	depends on WARP_CONFIG_MODE = 0
	default y if TARGET_mediatek_mt7986 || TARGET_mediatek_mt7981 || TARGET_mediatek_mt7988
	default n
	help
		Value will be set depending on TARGET, default not need set by user.

config WARP_DBG_SUPPORT
	bool "WARP Driver Debug Info Support"
	default y

config MTK_MEMORY_SHRINK
	bool "WARP Driver Memory Shrink"
	default n

config WARP_MEMORY_LEAK_DBG
	bool "Memory leak debug"
	depends on WARP_CONFIG_MODE = 0
	depends on !MTK_MEMORY_SHRINK && WARP_DBG_SUPPORT
	default y

config WARP_BM_SHRINK_RING
	bool "Shrink WARP BM ring to actual pkt/page count"
	default n
	help
	  Allocate WARP TXBM/RXBM/PageBM ring descriptors according to
	  actual pkt_num/page_num instead of fixed 65536 entries.

config WARP_RX_PAGE_BM_NUM
	int "WARP RX Page BM number"
	default 8192
	range 1024 8192

config WARP_WO_EMBEDDED_LOAD
	bool "WARP Driver Emebedded MCU FW"
	default n
	depends on WED_HW_RRO_SUPPORT
	help
		Once enabled, firmware download flow try embedded version once externel version being invalid.

endif
```
