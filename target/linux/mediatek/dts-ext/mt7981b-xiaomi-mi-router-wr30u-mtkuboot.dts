// SPDX-License-Identifier: GPL-2.0-or-later OR MIT

/dts-v1/;
#include "../dts/mt7981b-xiaomi-mi-router-wr30u.dtsi"

/ {
	model = "Xiaomi Mi Router WR30U (MTK U-Boot layout)";
	compatible = "xiaomi,mi-router-wr30u-mtkuboot", "mediatek,mt7981";
};

&spi_nand {
	mediatek,nmbm;
	mediatek,bmt-max-ratio = <1>;
	mediatek,bmt-max-reserved-blocks = <64>;
	mediatek,bmt-mtd-overridden-oobsize = <64>;
};

&partitions {
	partition@600000 {
		label = "ubi";
		reg = <0x600000 0x7000000>;
	};
};
