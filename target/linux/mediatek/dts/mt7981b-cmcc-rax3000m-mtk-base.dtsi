// SPDX-License-Identifier: GPL-2.0-or-later OR MIT

/dts-v1/;
#include "mt7981b-cmcc-rax3000m.dts"

/ {
	model = "CMCC RAX3000M (MTK UBoot base)";
	compatible = "cmcc,rax3000m", "mediatek,mt7981";

};

&chosen {
	/delete-property/ bootargs-override;
};